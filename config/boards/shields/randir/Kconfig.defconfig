## config/boards/shields/randir/Kconfig.defconfig
```kconfig
if SHIELD_RANDIR_LEFT

config ZMK_KEYBOARD_NAME
    default "Randir Left"

endif

if SHIELD_RANDIR_RIGHT

config ZMK_KEYBOARD_NAME
    default "Randir Right"

endif
```

## config/boards/shields/randir/Kconfig.shield
```kconfig
config SHIELD_RANDIR
    def_bool $(shields_list_contains,randir)
	
config SHIELD_RANDIR_LEFT
    def_bool $(shields_list_contains,randir_left)

config SHIELD_RANDIR_RIGHT
    def_bool $(shields_list_contains,randir_right)
	
CONFIG_ZMK_COMBO_MAX_PRESSED_COMBOS=1
CONFIG_ZMK_COMBO_MAX_COMBOS_PER_KEY=256
CONFIG_ZMK_COMBO_MAX_KEYS_PER_COMBO=10
```

## config/west.yml
```yaml
manifest:
  remotes:
    - name: zmkfirmware
      url-base: https://github.com/zmkfirmware
    - name: codeandr3w
      url-base: https://github.com/codeandr3w
    - name: tewtham
      url-base: https://github.com/tewtham
  projects:
#    - name: zmk
#      remote: zmkfirmware
#      revision: main
#      import: app/west.yml
#    - name: zmk-joystick
#      remote: codeandr3w
#      revision: mousepr-andrew
#      import: app/west.yml
    - name: zmk-joystick
      remote: codeandr3w
      revision: joystickpr
      import: app/west.yml
#    - name: zmk
#      remote: tewtham
#      revision: dactyl_typesafe
#      import: app/west.yml
  self:
    path: config
```
